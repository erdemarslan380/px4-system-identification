## overlay/src/modules/custom_pos_control/Kconfig
```kconfig
menuconfig MODULES_CUSTOM_POS_CONTROL
    bool "System-identification position forwarder"
    default n
    ---help---
        Minimal forwarding module used by the PX4 system-identification workspace.
```

## overlay/src/modules/trajectory_reader/Kconfig
```kconfig
menuconfig MODULES_TRAJECTORY_READER
    bool "System-identification trajectory reader"
    default n
    ---help---
        Publishes baseline hover references, prerecorded trajectories, and built-in identification motions.
```
